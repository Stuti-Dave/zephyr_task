## blink_delay/sample.yaml
```yaml
sample:
  name: Blinky Sample
tests:
  sample.basic.blinky:
    tags:
     - LED
      - gpio
    filter: 
      - dt_enabled_alias_with_parent_compat("led0", "gpio-leds")
      - dt_enabled_alias_with_parent_compat("led1", "gpio-leds")
      - dt_enabled_alias_with_parent_compat("led2", "gpio-leds")
      - dt_enabled_alias_with_parent_compat("led3", "gpio-leds")
    depends_on: gpio
    harness: led
    integration_platforms:
      - frdm_k64f
```

## button_led/sample.yaml
```yaml
sample:
  name: Button LED
tests:
  tasks.button_led:
    tags:
      - button
      - LED
      - gpio
    filter: 
      - dt_enabled_alias_with_parent_compat("led2", "gpio-leds")
      - dt_enabled_alias_with_parent_compat("sw0", "gpio-keys")
    depends on: gpio
    harness:
      - led
      - button
    integration_platforms:
      - nrf52833dk/nrf52820
      - frdm_k64f
```

## button_led_pwm/sample.yaml
```yaml
sample:
  name: Blink LED with button(PWM based)
tests:
  tasks.button_led_pwm:
    filter: 
      - dt_alias_exists("pwm-led1") and dt_compat_enabled("pwm-leds")
      - dt_enabled_alias_with_parent_compat("sw0", "gpio-keys")
    integration_platforms:
      - esp32c3_devkitm
      - nrf52833dk/nrf52820
    tags:
      - drivers
      - pwm
      - button
      - gpio
    depends_on: 
      - pwm
      - gpio
    harness: 
      - console
      - button
    harness_config:
      type: multi_line
      ordered: true
      regex:
        - "PWM-based blinky"
        - "Calibrating for channel [0-9]+"
        - "Done calibrating; maximum/minimum periods [0-9]+/[0-9]+ nsec"
        - "Using period [0-9]+"
        - "Using period [0-9]+"
```
